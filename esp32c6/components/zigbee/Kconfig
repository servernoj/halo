## esp32c6/components/zigbee/Kconfig
```kconfig
menu "Zigbee Configuration"

    config ZIGBEE_CHANNEL
        int "Zigbee channel"
        range 11 26
        default 13
        help
            Zigbee network channel number

    config ZIGBEE_COORDINATOR_MAX_DEVICES
        int "Maximum number of devices"
        range 1 20
        default 10
        help
            Maximum number of end devices that can connect

    config ZIGBEE_PERMIT_JOIN_DURATION
        int "Default permit join duration (seconds)"
        range 0 255
        default 180
        help
            Default duration in seconds for which joining is permitted
            
endmenu
```

## esp32c6/sdkconfig.defaults
```kconfig
# Zigbee Configuration
CONFIG_ZB_ENABLED=y
CONFIG_ZB_ZCZR=y
CONFIG_IEEE802154_ENABLED=y

# Partition Table
CONFIG_PARTITION_TABLE_CUSTOM=y
CONFIG_PARTITION_TABLE_CUSTOM_FILENAME="partitions.csv"

# FreeRTOS
CONFIG_FREERTOS_TIMER_TASK_STACK_DEPTH=3072

# IRAM
CONFIG_I2C_ISR_IRAM_SAFE=y
CONFIG_LEDC_CTRL_FUNC_IN_IRAM=y
CONFIG_PCNT_CTRL_FUNC_IN_IRAM=y

# WiFi
CONFIG_ESP_WIFI_DPP_SUPPORT=y
```
